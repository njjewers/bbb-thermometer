/dts-v1/;

/ {
	compatible = "ti,beaglebone", "ti,beaglebone-black";
	part-number = "NJ-PRU-01";
	version = "00A0";
	exclusive-use = 
		/* the pin header uses */
		"P9.27",	/* pru0: pr1_pru0_pru_r30_5 */
		/* the hardware IP uses */
		"pru0",
		"P8.11",	/* pru0: pr1_pru0_pru_r30_15 */
		"P8.12",	/* pru0: pr1_pru0_pru_r30_14 */
		"P9.25",	/* pru0: pr1_pru0_pru_r30_7 */
		"P9.41",	/* pru0: pr1_pru0_pru_r30_6 */
		"P9.42",	/* pru0: pr1_pru0_pru_r30_4 */
		"P9.28",	/* pru0: pr1_pru0_pru_r30_3 */
		"P9.30",	/* pru0: pr1_pru0_pru_r30_2 */
		"P9.29",	/* pru0: pr1_pru0_pru_r30_1 */
		"P9.31";	/* pru0: pr1_pru0_pru_r30_0 */
				/* pru0: pr1_pru0_pru_r30_13 is on MMC0_CMD */
				/* pru0: pr1_pru0_pru_r30_12 is on MMC0_CLK */
				/* pru0: pr1_pru0_pru_r30_11 is on MMC0_DAT0 */
				/* pru0: pr1_pru0_pru_r30_10 is on MMC0_DAT1 */
				/* pru0: pr1_pru0_pru_r30_9 is on MMC0_DAT2 */
				/* pru0: pr1_pru0_pru_r30_8 is on MMC0_DAT3 */

	fragment@0 {
		target = <0xdeadbeef>;

		__overlay__ {

			pinmux_pru_gpio_pins {
				pinctrl-single,pins = <0x1a4 0xf>;
				linux,phandle = <0x2>;
				phandle = <0x2>;
			};

			pinmux_pru_pru_pins {
				pinctrl-single,pins = <
					0x1a4 0x25	/* mcasp0_fsr.pr1_pru0_pru_r30_5, MODE5 | OUTPUT | PRU */
					0x034 0x26	/* gpmc_ad13.pr1_pru0_pru_r30_15, MODE6 | OUTPUT | PRU */
					0x030 0x26	/* gpmc_ad12.pr1_pru0_pru_r30_14, MODE6 | OUTPUT | PRU */
					0x1ac 0x25	/* mcasp0_ahclkx.pr1_pru0_pru_r30_7, MODE5 | OUTPUT | PRU */
					0x1a8 0x25	/* mcasp0_axr1.pr1_pru0_pru_r30_6, MODE5 | OUTPUT | PRU */
					0x1a0 0x25	/* mcasp0_aclkr.pr1_pru0_pru_r30_4, MODE5 | OUTPUT | PRU */
					0x19c 0x25	/* mcasp0_ahclkr.pr1_pru0_pru_r30_3, MODE5 | OUTPUT | PRU */
					0x198 0x25	/* mcasp0_axr0.pr1_pru0_pru_r30_2, MODE5 | OUTPUT | PRU */
					0x194 0x25	/* mcasp0_fsx.pr1_pru0_pru_r30_1, MODE5 | OUTPUT | PRU */
					0x190 0x25	/* mcasp0_aclkx.pr1_pru0_pru_r30_0, MODE5 | OUTPUT | PRU */
				>;
				linux,phandle = <0x1>;
				phandle = <0x1>;
			};
		};
	};

	fragment@2 {
		target = <0xdeadbeef>;

		__overlay__ {
			status = "okay";
			pinctrl-names = "default";
			pinctrl-0 = <0x1>;
		};
	};

	__symbols__ {
		pru_gpio_pins = "/fragment@0/__overlay__/pinmux_pru_gpio_pins";
		pru_pru_pins = "/fragment@0/__overlay__/pinmux_pru_pru_pins";
	};

	__fixups__ {
		am33xx_pinmux = "/fragment@0:target:0";
		pruss = "/fragment@2:target:0";
	};

	__local_fixups__ {
		fixup = "/fragment@2/__overlay__:pinctrl-0:0";
	};
};
